## Kconfig
```kconfig
#
# Copyright 2014, NICTA
#
# This software may be distributed and modified according to the terms of
# the GNU General Public License version 2. Note that NO WARRANTY is provided.
# See "LICENSE_GPLv2.txt" for details.
#
# @TAG(NICTA_GPL)
#

mainmenu "CAmkES project configuration"

config COMMON_PATH
    string
    option env="COMMON_PATH"

menu "Kernel"
    source "kernel/Kconfig"
endmenu

menu "Libraries"
    source "libs/libboost/Kconfig"
    source "libs/libmuslc/Kconfig"
    source "libs/libsel4/Kconfig"
    source "libs/libsel4muslcsys/Kconfig"
    source "libs/libsel4muslccamkes/Kconfig"
    source "libs/libsel4platsupport/Kconfig"
    source "libs/libsel4utils/Kconfig"
    source "libs/libcpio/Kconfig"
    source "libs/libelf/Kconfig"
    source "libs/libsel4sync/Kconfig"
    source "libs/libsel4vspace/Kconfig"
    source "libs/libsel4vka/Kconfig"
    source "libs/libplatsupport/Kconfig"
    source "libs/libsel4debug/Kconfig"
    source "libs/libutils/Kconfig"
    source "libs/libsel4simple/Kconfig"
    source "libs/libsel4simple-stable/Kconfig"
    source "libs/libpci/Kconfig"
    source "libs/libsel4vmm/Kconfig"
    source "libs/libsel4allocman/Kconfig"
    source "libs/libsel4bench/Kconfig"
    source "libs/libsel4cxx/Kconfig"
    source "libs/libethdrivers/Kconfig"
    source "libs/liblwip/Kconfig"
endmenu

menu "Applications"
    source "apps/capdl-loader-experimental/Kconfig"
    source "apps/vm/Kconfig"
    source "apps/c162_twovm/Kconfig"
    source "apps/cxx/Kconfig"
endmenu

menu "VM Configuration"
    choice
        prompt "DMA Support Implementation"
        depends on APP_CAMKES_VM
        default APP_CAMKES_VM_GUEST_DMA_IOMMU
        help
            Select how hardware DMA support is implemented.
        config APP_CAMKES_VM_GUEST_DMA_ONE_TO_ONE
            bool "One to one physical address mapping"
        config APP_CAMKES_VM_GUEST_DMA_ONE_TO_ONE_UNSAFE
            bool "Mostly one to one physical address mapping (UNSAFE)"
        config APP_CAMKES_VM_GUEST_DMA_IOMMU
            bool "IOMMU"
        config APP_CAMKES_VM_GUEST_DMA_NONE
            bool "None"
    endchoice
endmenu

source "tools/camkes/Kconfig"
source "$COMMON_PATH/Kconfig"
```

## apps/c162_twovm/Kconfig
```kconfig
#
# Copyright 2014, NICTA
#
# This software may be distributed and modified according to the terms of
# the GNU General Public License version 2. Note that NO WARRANTY is provided.
# See "LICENSE_GPLv2.txt" for details.
#
# @TAG(NICTA_GPL)
#

menuconfig APP_VM_C162_TWOVM
    bool "VMM for C162 with two guests"
    default n
    depends on LIB_SEL4 && (LIB_MUSL_C || LIB_SEL4_C) && LIB_SEL4_VKA &&\
               LIB_SEL4_VMM && LIB_SEL4_UTILS && LIB_UTILS && LIB_SEL4_SIMPLE && LIB_SEL4_SIMPLE_STABLE && LIB_SEL4_PLAT_SUPPORT && LIB_LWIP
    help 
        Main application entry point for seL4 VMM. Should be run as the initial seL4 thread.
```

## apps/cma34cr_picotcp/Kconfig
```kconfig
#
# Copyright 2017, Data61
# Commonwealth Scientific and Industrial Research Organisation (CSIRO)
# ABN 41 687 119 230.
#
# This software may be distributed and modified according to the terms of
# the GNU General Public License version 2. Note that NO WARRANTY is provided.
# See "LICENSE_GPLv2.txt" for details.
#
# @TAG(DATA61_GPL)
#

menuconfig APP_VM_CMA34CR_PICOTCP
    bool "VMM for i7 cma34cr with picotcp networking."
    default n
    depends on LIB_SEL4 && (LIB_MUSL_C || LIB_SEL4_C) && LIB_SEL4_VKA &&\
               LIB_SEL4_VMM && LIB_SEL4_UTILS && LIB_UTILS && LIB_SEL4_SIMPLE && LIB_SEL4_SIMPLE_DEFAULT && LIB_SEL4_PLAT_SUPPORT && LIB_PICOTCP
    help 
        Main application entry point for seL4 VMM. Should be run as the initial seL4 thread. This app demonstrates the use of PicoTCP's network stack
        used as a camkes component. 
```

## apps/cxx/Kconfig
```kconfig
#
# Copyright 2014, NICTA
#
# This software may be distributed and modified according to the terms of
# the BSD 2-Clause license. Note that NO WARRANTY is provided.
# See "LICENSE_BSD2.txt" for details.
#
# @TAG(NICTA_BSD)
#

config APP_CXX
    bool "Simple CAmkES application"
    default n
    depends on LIB_SEL4_CXX
    select APP_CAMKES_CXX
    help
        A simple application to demonstrate C++ building
```

## apps/vm/Kconfig
```kconfig
#
# Copyright 2017, Data61
# Commonwealth Scientific and Industrial Research Organisation (CSIRO)
# ABN 41 687 119 230.
#
# This software may be distributed and modified according to the terms of
# the GNU General Public License version 2. Note that NO WARRANTY is provided.
# See "LICENSE_GPLv2.txt" for details.
#
# @TAG(DATA61_GPL)
#

menuconfig APP_CAMKES_VM
    bool "VMM Main Application"
    default n
    depends on LIB_SEL4 && (LIB_MUSL_C || LIB_SEL4_C) && LIB_SEL4_VKA &&\
               LIB_SEL4_VMM && LIB_SEL4_UTILS && LIB_UTILS && LIB_SEL4_SIMPLE && LIB_SEL4_PLAT_SUPPORT && LIB_LWIP
    help 
        Main application entry point for seL4 VMM. Should be run as the initial seL4 thread.

config APP_CAMKES_VM_CONFIG
    prompt "Configuration"
    string
    depends on APP_CAMKES_VM
    default "optiplex9020"
    help
        Specify which of the configurations (in apps/vm/configurations) to use
        You can add additional configurations by adding a new .h file and updating
        apps/vm/configurations/vm.h accordingly    

config APP_CAMKES_VM_NUM_VM
    int "Number of guests"
    default 1
    depends on APP_CAMKES_VM
    help
        This option may be used by your selected configuration, or it may be
        overriden
```

## libsel4cxx/Kconfig
```kconfig
#
# Copyright 2017, Data61
# Commonwealth Scientific and Industrial Research Organisation (CSIRO)
# ABN 41 687 119 230.
#
# This software may be distributed and modified according to the terms of
# the BSD 2-Clause license. Note that NO WARRANTY is provided.
# See "LICENSE_BSD2.txt" for details.
#
# @TAG(DATA61_BSD)
#

menuconfig LIB_SEL4_CXX
    bool "Support library for compiling C++ applications on seL4"
    default y
    help
        This library aims to add missing definitions between the GCC C++ standard library
        and the muslc standard library. Hopefully this allows a regular STL and C++ support
        library to be compiled and linked in, but this whole thing is a hack
```
